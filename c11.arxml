AUTOSAR XML (schema 00046)
package /SoftwareTypes/ComponentTypes
  composition sw component type c1
    component c11
