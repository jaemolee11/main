AUTOSAR XML (schema 00046)
package /SoftwareTypes/ComponentTypes
  composition sw component type r1
    component c1
